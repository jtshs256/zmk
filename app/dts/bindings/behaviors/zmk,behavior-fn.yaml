## app/dts/bindings/behaviors/zmk,behavior-fn.yaml
```yaml
description: Fn key state and SYM Fn Lock behavior

compatible: "zmk,behavior-fn"

include: one_param.yaml
```

## app/dts/bindings/behaviors/zmk,behavior-host-lock-toggle.yaml
```yaml
description: Host Fn+Esc keyboard lock toggle behavior

compatible: "zmk,behavior-host-lock-toggle"

include: zero_param.yaml
```

## app/dts/bindings/behaviors/zmk,behavior-trackpad-light.yaml
```yaml
# Copyright (c) 2026 The ZMK Contributors
# SPDX-License-Identifier: MIT

description: |
  Control the trackpad light. The parameter is TPL_OFF, TPL_ON or TPL_TOG
  (saved across power cycles), TPL_CYCLE (when
  CONFIG_ZMK_TRACKPAD_LIGHT_CYCLE is enabled), or TPL_SUSPEND and TPL_RESUME,
  which hold it off and let it go again without changing the saved choice (for
  a lock). See dt-bindings/zmk/trackpad.h.

compatible: "zmk,behavior-trackpad-light"

include: one_param.yaml
```

## app/dts/bindings/behaviors/zmk,behavior-uconsole-lock-toggle.yaml
```yaml
description: uConsole Fn+Esc keyboard lock toggle behavior

compatible: "zmk,behavior-uconsole-lock-toggle"

include: zero_param.yaml
```

## app/dts/bindings/behaviors/zmk,behavior-uconsole-unlock.yaml
```yaml
description: uConsole keyboard unlock behavior

compatible: "zmk,behavior-uconsole-unlock"

include: zero_param.yaml
```
